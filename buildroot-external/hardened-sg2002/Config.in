## buildroot-external/hardened-sg2002/Config.in
```kconfig
menu "Hardened NanoKVM SG2002 port options"

config BR2_HARDENED_SG2002_VENDOR_ABI_READY
	bool "allow the vendor multimedia ABI in a lab image"
	help
	  This acknowledgement does not prove compatibility. It only permits a
	  non-release, recoverable-media image to carry the pinned vendor runtime
	  so that loader and hardware compatibility can be tested on SG2002.

source "$BR2_EXTERNAL_HARDENED_SG2002_PATH/package/hardened-sg2002-codec-firmware/Config.in"
source "$BR2_EXTERNAL_HARDENED_SG2002_PATH/package/hardened-aic8800-sdio-firmware/Config.in"
source "$BR2_EXTERNAL_HARDENED_SG2002_PATH/package/hardened-cvitek-riscv64-musl-sysroot/Config.in"
source "$BR2_EXTERNAL_HARDENED_SG2002_PATH/package/hardened-nanokvm-kvmapp/Config.in"
source "$BR2_EXTERNAL_HARDENED_SG2002_PATH/package/hardened-sg2002-vendor-runtime/Config.in"

endmenu
```

## buildroot-external/hardened-sg2002/configs/hardened_sg2002_licheervnano_defconfig
```kconfig
BR2_riscv=y
BR2_RISCV_ISA_RVC=y
BR2_TOOLCHAIN_BUILDROOT_MUSL=y
BR2_KERNEL_HEADERS_5_10=y
BR2_TOOLCHAIN_BUILDROOT_CXX=y
BR2_GCC_ENABLE_OPENMP=y
BR2_DOWNLOAD_FORCE_CHECK_HASHES=y
BR2_REPRODUCIBLE=y
BR2_GLOBAL_PATCH_DIR="$(BR2_EXTERNAL_HARDENED_SG2002_PATH)/board/sg2002/patches"
BR2_STRIP_EXCLUDE_FILES="NanoKVM-Server nanokvm-hwmon kvm_system libkvm.so libkvm_mmf.so soph_vcodec.ko soph_jpeg.ko soph_vc_driver.ko"
BR2_TARGET_GENERIC_HOSTNAME="hardened-sg2002-port"
BR2_TARGET_GENERIC_ISSUE="Hardened NanoKVM SG2002 Buildroot port probe"
# BR2_TARGET_ENABLE_ROOT_LOGIN is not set
BR2_INIT_SYSV=y
BR2_ROOTFS_DEVICE_CREATION_DYNAMIC_EUDEV=y
BR2_ROOTFS_MERGED_USR=y
BR2_ROOTFS_OVERLAY="$(BR2_EXTERNAL_HARDENED_SG2002_PATH)/board/sg2002/overlay"
BR2_ROOTFS_POST_BUILD_SCRIPT="$(BR2_EXTERNAL_HARDENED_SG2002_PATH)/board/sg2002/post-build.sh"
BR2_PACKAGE_BUSYBOX_CONFIG_FRAGMENT_FILES="$(BR2_EXTERNAL_HARDENED_SG2002_PATH)/board/sg2002/busybox.fragment"
BR2_PACKAGE_E2FSPROGS=y
BR2_PACKAGE_E2FSPROGS_RESIZE2FS=y
BR2_PACKAGE_EXFATPROGS=y
BR2_PACKAGE_I2C_TOOLS=y
BR2_PACKAGE_PARTED=y
BR2_PACKAGE_NANO=y
BR2_PACKAGE_PICOCOM=y
BR2_PACKAGE_CA_CERTIFICATES=y
BR2_PACKAGE_LIBOPENSSL_BIN=y
# BR2_PACKAGE_LIBOPENSSL_ENABLE_QUIC is not set
# BR2_PACKAGE_LIBOPENSSL_ENABLE_RC2 is not set
# BR2_PACKAGE_LIBOPENSSL_ENABLE_RC4 is not set
# BR2_PACKAGE_LIBOPENSSL_ENABLE_MD2 is not set
# BR2_PACKAGE_LIBOPENSSL_ENABLE_SSL3 is not set
# BR2_PACKAGE_LIBOPENSSL_ENABLE_WEAK_SSL is not set
# BR2_PACKAGE_LIBOPENSSL_UNSECURE is not set
# BR2_PACKAGE_LIBOPENSSL_DYNAMIC_ENGINE is not set
BR2_PACKAGE_LIBCURL=y
BR2_PACKAGE_LIBCURL_CURL=y
# BR2_PACKAGE_LIBCURL_EXTRA_PROTOCOLS_FEATURES is not set
BR2_PACKAGE_AVAHI=y
# BR2_PACKAGE_AVAHI_AUTOIPD is not set
BR2_PACKAGE_AVAHI_DAEMON=y
BR2_PACKAGE_AVAHI_DEFAULT_SERVICES=y
BR2_PACKAGE_HOSTAPD=y
# BR2_PACKAGE_HOSTAPD_DRIVER_HOSTAP is not set
BR2_PACKAGE_HOSTAPD_DRIVER_NL80211=y
# BR2_PACKAGE_HOSTAPD_ACS is not set
# BR2_PACKAGE_HOSTAPD_VLAN is not set
BR2_PACKAGE_IPROUTE2=y
BR2_PACKAGE_IPTABLES=y
BR2_PACKAGE_IPTABLES_NFTABLES=y
BR2_PACKAGE_IPUTILS=y
BR2_PACKAGE_NTP=y
BR2_PACKAGE_NTP_NTPDATE=y
BR2_PACKAGE_OPENSSH=y
BR2_PACKAGE_WIREGUARD_TOOLS=y
BR2_PACKAGE_WPA_SUPPLICANT=y
BR2_PACKAGE_WPA_SUPPLICANT_WEXT=y
BR2_PACKAGE_WPA_SUPPLICANT_PASSPHRASE=y
BR2_TARGET_ROOTFS_EXT2=y
BR2_TARGET_ROOTFS_EXT2_4=y
BR2_TARGET_ROOTFS_EXT2_SIZE="1536M"
BR2_TARGET_ROOTFS_EXT2_MKFS_OPTIONS="-O ^64bit -U 23df1b1c-cbf0-5e1c-b42b-de68dec5ad95 -E hash_seed=23df1b1c-cbf0-5e1c-b42b-de68dec5ad95"
BR2_TARGET_TZ_INFO=y
BR2_PACKAGE_HOST_GENIMAGE=y
BR2_HARDENED_SG2002_VENDOR_ABI_READY=y
BR2_PACKAGE_HARDENED_SG2002_CODEC_FIRMWARE=y
BR2_PACKAGE_HARDENED_AIC8800_SDIO_FIRMWARE=y
BR2_PACKAGE_HARDENED_SG2002_VENDOR_RUNTIME=y
```

## buildroot-external/hardened-sg2002/package/hardened-aic8800-sdio-firmware/Config.in
```kconfig
config BR2_PACKAGE_HARDENED_AIC8800_SDIO_FIRMWARE
	bool "AIC8800 SDIO Wi-Fi firmware (vendor port input)"
	depends on BR2_riscv
	help
	  Install the immutable AIC8800 firmware input under
	  /usr/lib/firmware/aic8800_sdio. It is disabled by default because the
	  matching kernel driver and license review are not yet part of the port.
```

## buildroot-external/hardened-sg2002/package/hardened-cvitek-riscv64-musl-sysroot/Config.in
```kconfig
config BR2_PACKAGE_HARDENED_CVITEK_RISCV64_MUSL_SYSROOT
	bool "CVITEK RV64 musl runtime sysroot (ABI experiment)"
	depends on BR2_riscv
	depends on BR2_HARDENED_SG2002_VENDOR_ABI_READY
	help
	  Install the vendor runtime sysroot for an explicitly verified ABI
	  experiment. This package can overwrite or shadow Buildroot runtime
	  libraries. Do not enable it until the full MMF/VENC/libkvm loader
	  closure and license review have passed on SG2002 hardware.
```

## buildroot-external/hardened-sg2002/package/hardened-nanokvm-kvmapp/Config.in
```kconfig
config BR2_PACKAGE_HARDENED_NANOKVM_KVMAPP
	bool "Hardened NanoKVM application payload"
	depends on BR2_RISCV_64
	help
	  Install the locally built Hardened NanoKVM Rust application, native
	  runtime libraries, web assets, hardware helper, init scripts, and
	  system-update public key into the SG2002 rootfs.

	  The package expects build/kvmapp-rust/kvmapp to exist in the parent
	  project. It does not build the application or prove vendor multimedia
	  ABI compatibility.
```

## buildroot-external/hardened-sg2002/package/hardened-sg2002-codec-firmware/Config.in
```kconfig
config BR2_PACKAGE_HARDENED_SG2002_CODEC_FIRMWARE
	bool "SG2002 codec firmware (vendor port input)"
	depends on BR2_riscv
	help
	  Install the immutable vendor codec firmware input under
	  /usr/share/fw_vcodec. This does not provide the CVI MMF/VENC userspace
	  stack and must not be treated as a functional video implementation.

	  The archive has no reviewed license declaration. It is restricted to
	  port-lab use until legal redistribution approval is recorded.
```

## buildroot-external/hardened-sg2002/package/hardened-sg2002-vendor-runtime/Config.in
```kconfig
config BR2_PACKAGE_HARDENED_SG2002_VENDOR_RUNTIME
	bool "SG2002 vendor MMF/kernel runtime (lab input)"
	depends on BR2_RISCV_64
	depends on BR2_HARDENED_SG2002_VENDOR_ABI_READY
	select BR2_PACKAGE_HARDENED_NANOKVM_KVMAPP
	help
	  Install the prepared /mnt/system vendor BSP runtime and the pinned
	  OpenCV/protobuf dependency closure needed by the current libkvm build.

	  This input is generated from the pinned vendor rootfs and is restricted
	  to recoverable-media testing. It is not approved for redistribution or
	  a stable raw update.
```
